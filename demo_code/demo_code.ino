#include <OctoWS2811.h>
#include <Audio.h>
#include <Wire.h>
#include <SD.h>
#include <SPI.h>

#define LIGHTING 0
#define COLOR 1
#define RANDOM 2
#define PLASMA 3

//Color Temp to RGB lookup table generated from data available at http://www.tannerhelland.com/4435/convert-temperature-rgb-algorithm-code/
const unsigned char r_k[] = {255, 255, 255, 255, 255, 255, 255, 255, 255, 255, 255, 255, 255,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 155, 155};
const unsigned char g_k[] = {56, 71, 83, 93, 101, 109, 115, 121, 126, 131, 137, 142, 147,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 188, 188};
const unsigned char b_k[] = {0, 0, 0, 0, 0, 0, 0, 0, 0, 0, 18, 33, 44,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 255, 255};
unsigned char gamma_lookup[256];

const int leds_per_pin = 120;
DMAMEM int display_memory[leds_per_pin * 6];
int drawing_memory[leds_per_pin * 6];
const int config = WS2811_GRB | WS2811_800kHz;
OctoWS2811 leds(leds_per_pin, display_memory, drawing_memory, config);
String serial_input = "";
boolean new_command = false;
unsigned int color_temp = 10000;
unsigned int rgb_r = 0;
unsigned int rgb_g = 0;
unsigned int rgb_b = 0;
unsigned int bright = 0;
float gam = 2.5;
char buf[10];
unsigned int mode = LIGHTING;

void setup()
{
  set_gamma(gam);
  leds.begin();
  //Serial1.begin(9600);
  Serial.begin(115200);
  serial_input.reserve(50);
  Serial.println("Demo Mode");
}

void loop()
{
  Serial.println("Sweeping Color Temperature");
  for(unsigned int k = 1000; k < 40000; k+= 10)
  {
    set_color_temp(k, 35);
    if (k % 1000 == 0)
    {
      Serial.print("Color temp: ");
      Serial.print(k);
      Serial.println("K");
    }
  }
  Serial.println("RGB Colors");
  for (unsigned int i = 0; i < 10; i++)
  {
    unsigned int r_t = random(0, 255);
    unsigned int g_t = random(0, 255);
    unsigned int b_t = random(0, 255);
    set_color(r_t, g_t, b_t, 35);
    Serial.print("R: ");
    Serial.print(r_t);
    Serial.print(", G: ");
    Serial.print(g_t);
    Serial.print(", B: ");
    Serial.println(b_t);
    delay(1000);
  }
  Serial.println("Random pattern");
  for (unsigned int i = 0; i < 1000; i++)
  {
    set_random(50);
  }
  Serial.println("Plasma pattern");
  for (unsigned int i = 0; i < 20; i++)
  {
    plasma(30);
  }
}

void set_color_temp(unsigned int k, unsigned int brightness)
{
  if (k > 999 && k < 40001 && brightness < 101)
  {
      k -= 1000;
      k /= 100;
      unsigned int corr = ((unsigned int) r_k[k]) * brightness;
      unsigned int corg = ((unsigned int) g_k[k]) * brightness;
      unsigned int corb = ((unsigned int) b_k[k]) * brightness;
      corr /= 100;
      corg /= 100;
      corb /= 100;
      corr = min(corr, 255);
      corg = min(corg, 255);
      corb = min(corb, 255);
      corr = gamma_lookup[corr];
      corg = gamma_lookup[corg];
      corb = gamma_lookup[corb];
      for (unsigned int i = 0; i < 8 * leds_per_pin; i++)
      {
        leds.setPixel(i, corr, corg, corb);
      }
  }
  leds.show();
}

void set_gamma(float g) //Generate a gamma correction lookup table (quanitization sucks)
{
  for (unsigned int i = 0; i < 256; i++)
  {
      gamma_lookup[i] = (unsigned char) (pow((float)i / (float)255, g) * 255 + 0.5);
  }
}

void set_color(unsigned int r, unsigned int g, unsigned int b, unsigned int brightness)
{
  r *= brightness;
  g *= brightness;
  b *= brightness;
  r /= 100;
  g /= 100;
  b /= 100;
  r = min(r, 255);
  g = min(g, 255);
  b = min(b, 255);
  r = gamma_lookup[r];
  g = gamma_lookup[g];
  b = gamma_lookup[b];
  for (unsigned int i = 0; i < 8 * leds_per_pin; i++)
  {
    leds.setPixel(i, r, g, b);
  }
  leds.show();
}

void set_random(unsigned int brightness)
{
  brightness = (unsigned int) (((float) brightness) * 2.55f);
  for (unsigned int i = 0; i < 8 * leds_per_pin; i++)
  {
    leds.setPixel(i, gamma_lookup[random(0, brightness)], gamma_lookup[random(0, brightness)], gamma_lookup[random(0, brightness)]);
    //leds.setPixel(i, random(0, brightness), random(0, brightness), random(0, brightness));
  }
  leds.show();
}

float dist(unsigned int x, unsigned int y)
{
  return sqrt((x-6)*(x-6)+(y-5)*(y-5));
}

void plasma(unsigned int brightness)
{
  int rp = 0;
  int gp = 0;
  int bp = 0;
  unsigned int i;
  for (float t = 0; t < 6.25; t+= 0.25)
  {
    for (unsigned int x = 0; x < 12; x++)
    {
      for (unsigned int y = 0; y < 10; y++)
      {
        rp = 64 * (-sin(x + t) + sin(y - t) - sin(x + y + t) + sin(dist(x, y) - t)) + 255;
        gp = 64 * (sin(x - t) - sin(y + t) + sin(x + y - t) - sin(dist(x, y) + t)) + 255;
        bp = 64 * (sin(x + t) + sin(y + t) + sin(x + y + t) + sin(dist(x, y) + t)) + 255;
        rp *= brightness;
        rp /= 100;
        gp *= brightness;
        gp /= 100;
        bp *= brightness;
        bp /= 100;
        rp = max(min(rp, 255), 0);
        gp = max(min(gp, 255), 0);
        bp = max(min(bp, 255), 0);
        i = x + (12 * y) + 240;
        leds.setPixel(i, gamma_lookup[rp], gamma_lookup[gp], gamma_lookup[bp]);
      }
    }
    while(leds.busy());
    leds.show();
  }
}
